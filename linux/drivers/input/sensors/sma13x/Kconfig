## linux/drivers/input/sensors/sma13x/Kconfig
```kconfig
menuconfig SENSOR_SMA13X
	bool "Bosch Sensor SMA13X"
	help
	  if you choose this option, a list of SMA13X features will be displayed.

	  If unsure, say N.

if SENSOR_SMA13X

choice
	prompt "Select communication interface"
	depends on SENSOR_SMA13X
	help
	  Note: SPI and I2C are not supported at the same time, that is to say:
	  Choose either SPI or I2C to build the driver.

    config SMA13X_SPI
	bool "Enable SPI connection"
	depends on SPI_MASTER
    config SMA13X_I2C
	bool "Enable I2C connection"
	depends on I2C
endchoice

config SMA13X_DRIVER
	tristate "SMA13X all in one driver"
	depends on (I2C || SPI_MASTER) && SYSFS
	help
	 SMA13X driver, spi supported only for now.

config SMA13X_ENABLE_INT
	bool "Enable interupt"
	help
	 If this option is enabled, interupt will be generated 

config SMA13X_NEWDATA_INT
	bool "Enable new data interupt"
	depends on SMA13X_ENABLE_INT
	help
	 If this option is enabled, new data interupt will be generated 

config SMA13X_HIGH_G
	bool "Enable high-g detection"
	depends on SMA13X_ENABLE_INT
	help
	 If this option is enabled, high-g will be detected

config SMA13X_SLOPE
	bool "Enable slope/any-motion detection"
	depends on SMA13X_ENABLE_INT
	help
	 If this option is enabled, slope/any-motion will be detected

config SMA13X_NO_MOTION
	bool "Enable no-motion detection"
	depends on SMA13X_ENABLE_INT
	help
	 If this option is enabled, no-motion will be detected

config BOSCH_DRIVER_LOG_FUNC
	bool "Smart log function support"
	help
	 If you say yes here, you get support for smart log function in Bosch sensor driver.

endif
```
